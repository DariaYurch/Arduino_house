//..................................................................
#include <LiquidCrystal_I2C.h>
#include "DHT.h"
//.............................ИМПОРТИРУЕМ ВСЕ НЕОБХОДИМЫЕ БИБЛИОТЕКИ
//...................................................................
#define DHTPIN 2 
#define DHTTYPE DHT11 
#define MOTOR_PIN  9
int ss,modes,flag,pot,o,svet,p;
//..............................ИНИЦИАЛИЗИРУЕМ ВСЕ НУЖНЫЕ ПЕРЕМЕННЫЕ
//..................................................................
DHT dht(DHTPIN, DHTTYPE);
LiquidCrystal_I2C lcd(0x27,16,2); 
//..............................ОБЪЯВЛЯЕМ ВСЕ ИСПОЛЬЗУЕМЫЕ УСТРОЙСТВА
//...................................................................
int tempC(float a)
{
  lcd.print("Temp:");
  lcd.print(a);
  lcd.print("C");
}
int hum(float a)
{
  lcd.print("Humidity:");
  lcd.print(a);
  lcd.print("%");
}
//................................СОЗДАЕМ ФУНКЦИИ ДЛЯ ВЫВОДА ТЕМПЕРАТУРЫ И ВЛАЖНОСТИ
//................................................................................
void setup()
{
  Serial.begin(9600);
  pinMode(A0,INPUT);
  pinMode(A1,INPUT);
  pinMode(8,OUTPUT);
  pinMode(7,OUTPUT);
  pinMode(10,OUTPUT);
  pinMode(13,OUTPUT);
  pinMode(12,OUTPUT);
  pinMode(MOTOR_PIN, OUTPUT);
  dht.begin();
  lcd.init();                     
  lcd.backlight();
}
//..............................НАСТРАИВАЕМ ВСЕ НЕОБХОДИМЫЕ ПИНЫ(НА ВХОД ИЛИ ВЫХОД)

void loop()
{
  //..........ЧАСТЬ КОДА,КОТОРАЯ ПОСТОЯННО ОБНОВЛЯЕТ ДАННЫЕ О ТЕМПЕРАТУРЕ,ВЛАЖНОСТИ И СОСТОЯНИИ КНОПКИ,ОТВЕЧАЮЩЕЙ ЗА ВКЛЮЧЕНИЕ И ВЫКЛЮЧЕНИЕ СИСТЕМЫ ОСВЕЩЕНИЯ
  float h = dht.readHumidity();
  float t = dht.readTemperature();
  ss = digitalRead(7);
  //.........................................................................................................................................................
  if (ss == 1)//..........................ВКЛЮЧЕНИЕ СИСТЕМЫ ОСВЕЩЕНИЯ
  {
    ss = digitalRead(7);
    modes = digitalRead(8);
    if (modes == 0)
    {
      flag = 1;
      digitalWrite(12,LOW);
      digitalWrite(13,HIGH);
    }
    if(modes == 1)
    {
      flag = 0;
      digitalWrite(12,HIGH);
      digitalWrite(13,LOW);
    }
    delay(10);
      if(flag == 1)
      {
        pot = analogRead(A0);
        o = pot / 4;
        analogWrite(6,o);
      }
      if(flag == 0)
      { 
        svet = analogRead(A1);
        p = (1024 - svet) / 0.8;
        analogWrite(6,p);
  }
  }
  //..........................................
  else
  //......................ВЫКЛЮЧЕНИЕ СИСТЕМЫ ОСВЕЩЕНИЯ
  {
  digitalWrite(12,LOW);
  digitalWrite(13,LOW);
  digitalWrite(10,LOW);
  }
  //..................................................







  
  if (t > 30)
  //..................ВКЛЮЧЕНИЕ КУЛЕРА
  {
    analogWrite(9,255);
  }
  //...................................
  //...............ВЫКЛЮЧЕНИЕ КУЛЕРА
  else
  {
    analogWrite(9,0);
  }
  //..................................
  //...........................ПОСТОЯННЫЙ ВЫВОД ТЕМПЕРАТУРЫ И ВЛАЖНОСТИ НА ЭКРНА
  lcd.setCursor(0,0);
  tempC(t);
  lcd.setCursor(0,1);
  hum(h);
  delay(1000);
  //.............................................................................

}
